## config/west.yml
```yaml
manifest:
  remotes:
    - name: zmkfirmware
      url-base: https://github.com/zmkfirmware
    - name: quangdinh
      url-base: https://github.com/quangdinh
  projects:
    - name: zmk
      remote: zmkfirmware
      revision: v0.2.1
      import: app/west.yml
    - name: zmk-nice-view
      remote: quangdinh
      revision: main
  self:
    path: config
```
